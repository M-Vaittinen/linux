## Documentation/devicetree/bindings/power/supply/battery.yaml
```yaml
# SPDX-License-Identifier: (GPL-2.0-only OR BSD-2-Clause)
%YAML 1.2
---
$id: http://devicetree.org/schemas/power/supply/battery.yaml#
$schema: http://devicetree.org/meta-schemas/core.yaml#

title: Battery Characteristics

maintainers:
  - Sebastian Reichel <sre@kernel.org>

description: |
  The devicetree battery node provides static battery characteristics.
  Please, see the battery-generic.yaml for more detailed information.


properties:
  compatible:
    const: simple-battery

required:
  - compatible

allOf:
  - $ref: /schemas/power/supply/battery-generic.yaml#

unevaluatedProperties: false

examples:
  - |
    power {
      #address-cells = <1>;
      #size-cells = <0>;

      battery: battery {
        compatible = "simple-battery";
        over-voltage-threshold-microvolt = <4500000>;
        re-charge-voltage-microvolt = <250000>;
        voltage-min-design-microvolt = <3200000>;
        voltage-max-design-microvolt = <4200000>;
        energy-full-design-microwatt-hours = <5290000>;
        charge-full-design-microamp-hours = <1430000>;
        precharge-current-microamp = <256000>;
        precharge-upper-limit-microvolt = <2500000>;
        charge-term-current-microamp = <128000>;
        constant-charge-current-max-microamp = <900000>;
        constant-charge-voltage-max-microvolt = <4200000>;
        factory-internal-resistance-micro-ohms = <250000>;
        ocv-capacity-celsius = <(-10) 0 10>;
        /* table for -10 degree Celsius */
        ocv-capacity-table-0 = <4185000 100>, <4113000 95>, <4066000 90>;
        /* table for 0 degree Celsius */
        ocv-capacity-table-1 = <4200000 100>, <4185000 95>, <4113000 90>;
        /* table for 10 degree Celsius */
        ocv-capacity-table-2 = <4250000 100>, <4200000 95>, <4185000 90>;
        resistance-temp-table = <20 100>, <10 90>, <0 80>, <(-10) 60>;
        operating-range-celsius = <(-30) 50>;
        ambient-celsius = <(-5) 50>;
        alert-celsius = <0 40>;
      };

      charger@11 {
        reg = <0x11>;
        monitored-battery = <&battery>;
      };

      fuel-gauge@22 {
        reg = <0x22>;
        monitored-battery = <&battery>;
      };
    };
```

## Documentation/devicetree/bindings/power/supply/rohm,vdr-battery.yaml
```yaml
# SPDX-License-Identifier: (GPL-2.0-only OR BSD-2-Clause)
%YAML 1.2
---
$id: http://devicetree.org/schemas/power/supply/rohm,vdr-battery.yaml#
$schema: http://devicetree.org/meta-schemas/core.yaml#

title: Battery managed by the BD72720 PMIC

maintainers:
  - Matti Vaittinen <mazziesaccount@gmail.com>

description:
  A battery which has VDR parameters measuerd for ROHM chargers.

allOf:
  - $ref: battery-generic.yaml#

properties:
  compatible:
    const: rohm,vdr-battery

  rohm,voltage-vdr-thresh-microvolt:
    description: Threshold for starting the VDR correction
    maximum: 48000000

  rohm,volt-drop-soc-bp:
    description: Table of capacity values matching the values in VDR tables.
      The value should be given as basis points, 1/100 of a percent.

  rohm,volt-drop-temperatures-millicelsius:
    description: An array containing the temperature in milli celsius, for each
      of the VDR lookup table.

required:
  - compatible

patternProperties:
  '^rohm,volt-drop-[0-9]-microvolt':
    description: Table of the voltage drop rate (VDR) values. Each entry in the
      table should match a capacity value in the rohm,volt-drop-soc table.
      Furthermore, the values should be obtained for the temperature given in
      rohm,volt-drop-temperatures-millicelsius table at index matching the
      number in this table's name.

unevaluatedProperties: false

examples:
  - |
    power {
      #address-cells = <1>;
      #size-cells = <0>;

      battery: battery {
        compatible = "rohm,vdr-battery";

        ocv-capacity-celsius = <25>;
        ocv-capacity-table-0 = <4200000 100 4184314 100 4140723 95 4099487 90
          4060656 85 4024350 80 3991121 75 3954379 70 3913265 65 3877821 60
          3855577 55 3837466 50 3822194 45 3809012 40 3795984 35 3780647 30
          3760505 25 3741532 20 3718837 15 3696698 10 3690594 5 3581427 0>;

        rohm,volt-drop-soc-bp = <10000 10000 9500 9000 8500 8000 7500 7000 6500 6000 5500 5000
          4500 4000 3500 3000 2500 2000 1500 1000 500 0 (-500)>;

        rohm,volt-drop-temperatures-millicelsius = <45000 25000 5000 0>;

        rohm,volt-drop-0-microvolt =  <100 100 102 104 106 109 114 124
          117 107 107 109 112 116 117 108 109 109 108 109 122 126 130>;

        rohm,volt-drop-1-microvolt = <100 100 102 105 98 100 105 102
          101 99 98 100 103 105 109 117 111 109 110 114 128 141 154>;

        rohm,volt-drop-2-microvolt = <100 100 98 107 112 114 118 118 112
          108 108 110 111 113 117 123 131 144 157 181 220 283 399>;

        rohm,volt-drop-3-microvolt = <86 86 105 109 114 110 115 115
          110 108 110 112 114 118 124 134 136 160 177 201 241 322 403>;

        rohm,voltage-vdr-thresh-microvolt = <4150000>;

        charge-full-design-microamp-hours = <1799000>;
        voltage-max-design-microvolt = <4200000>;
        voltage-min-design-microvolt = <3500000>;
      };
    };
```

## Documentation/devicetree/bindings/regulator/rohm,bd71851-regulator.yaml
```yaml
# SPDX-License-Identifier: GPL-2.0-only OR BSD-2-Clause
%YAML 1.2
---
$id: http://devicetree.org/schemas/regulator/rohm,bd71851-regulator.yaml#
$schema: http://devicetree.org/meta-schemas/core.yaml#

title: ROHM BD71851 Power Management Integrated Circuit regulators

maintainers:
  - Matti Vaittinen <mazziesaccount@gmail.com>

description: |
  This module is part of the ROHM BD71851 MFD device. For more details
  see Documentation/devicetree/bindings/mfd/rohm,bd71851-pmic.yaml.

  The regulator controller is represented as a sub-node of the PMIC node
  on the device tree.

  Regulator nodes should be named to buck_<number> and ldo_<number>.
  The valid names for BD71851 regulator nodes are
  buck1, buck2, buck3, buck4, buck5, buck6, buck7, buck8
  ldo1, ldo2, ldo3, ldo4

patternProperties:
  "^buck[1-8]$":
    type: object
    description:
      Properties for a single BUCK regulator.
    $ref: regulator.yaml#

    properties:
      regulator-name:
        pattern: "^buck[1-8]$"
        description:
          should be "buck1", ..., "buck8"

      rohm,dvs-run-voltage:
        description:
          PMIC default "RUN" state voltage in uV. 0 means disabled. See the
          explanation below for regulator specific details.
        $ref: /schemas/types.yaml#/definitions/uint32
        minimum: 0
        maximum: 3500000

      rohm,dvs-idle-voltage:
        description:
          PMIC default "IDLE" state voltage in uV. 0 means disabled. See the
          explanation below for regulator specific details.
        $ref: /schemas/types.yaml#/definitions/uint32
        minimum: 0
        maximum: 3500000

      rohm,dvs-suspend-voltage:
        description:
          PMIC default "SUSPEND" state voltage in uV. 0 means disabled. See the
          explanation below for regulator specific details.
        $ref: /schemas/types.yaml#/definitions/uint32
        minimum: 0
        maximum: 3500000

        # BUCKs 1,2,3,4 and 8 support voltages 0.5 - 1.3V
        # BUCK 5 supports voltages 0.3 - 1.3V
        # BUCKs 6 and 7 support voltages 1.5 - 3.5V

    required:
      - regulator-name

    unevaluatedProperties: false

  "^ldo[1-4]$":
    type: object
    description:
      Properties for single LDO regulator.
    $ref: regulator.yaml#

    properties:
      regulator-name:
        pattern: "^ldo[1-4]$"
        description:
          should be "ldo1", ..., "ldo7"

      rohm,dvs-run-voltage:
        description:
          Set the default output state at PMIC's "RUN" state.
          0 is disabled, 1 is enabled.
        $ref: /schemas/types.yaml#/definitions/uint32
        minimum: 0
        maximum: 1

      rohm,dvs-idle-voltage:
        description:
          Set the default output state at PMIC's "IDLE" state.
          0 is disabled, 1 is enabled.
        $ref: /schemas/types.yaml#/definitions/uint32
        minimum: 0
        maximum: 1

      rohm,dvs-suspend-voltage:
        description:
          Set the default output state at PMIC's "SUSPEND" state.
          0 is disabled, 1 is enabled.
        $ref: /schemas/types.yaml#/definitions/uint32
        minimum: 0
        maximum: 1

      rohm,ldo-range-high:
        type: boolean
        description:
          LDO1 and LDO3 voltage ranges can be "high" or "low" depending on
          OTP. Indicate that the "high" range is used. See comment below
          for voltages.

        # LDOs 2 and 4 support voltages 0.75 - 3.3V
        # LDOs 1 and 3 may support different ranges depending on OTP.
        # either 0.6 - 1.8V or 0.75 - 3.3V.

    unevaluatedProperties: false

additionalProperties: false
```
