## Documentation/devicetree/bindings/iio/accel/kionix,kx022a.yaml
```yaml
# SPDX-License-Identifier: GPL-2.0-only OR BSD-2-Clause
%YAML 1.2
---
$id: http://devicetree.org/schemas/iio/accel/kionix,kx022a.yaml#
$schema: http://devicetree.org/meta-schemas/core.yaml#

title: ROHM/Kionix KX022A Accelerometer bindings

maintainers:
  - Matti Vaittinen <matti.vaittinen@fi.rohmeurope.com>

description: |
  KX022A is a 3-axis accelerometer supporting +/- 2G, 4G, 8G and 16G ranges,
  output data-rates from 0.78Hz to 1600Hz and a hardware-fifo buffering.
  KX022A can be accessed either via I2C or SPI.

properties:
  compatible: kionix,kx022a

  reg:
    description:
      I2C slave address or SPI chip-select.
    maxItems: 1

  interrupts:
    maxItems: 1

  vdd-supply: true
  io_vdd-supply: true

  mount-matrix:
    description: |
      an optional 3x3 mounting rotation matrix.

required:
  - compatible
  - reg
  - interrupts

additionalProperties: false

examples:
  - |
    #include <dt-bindings/interrupt-controller/irq.h>
    i2c {
        #address-cells = <1>;
        #size-cells = <0>;
          accel@1f {
            compatible = "kionix,kx022a";
            reg = <0x1f>;

            interrupt-parent = <&gpio1>;
            interrupts = <29 IRQ_TYPE_LEVEL_LOW>;

            io_vdd-supply = <&iovdd>;
            vdd-supply = <&vdd>;
        };
    };
```

## Documentation/devicetree/bindings/input/kionix,kx022a.yaml
```yaml
# SPDX-License-Identifier: GPL-2.0-only OR BSD-2-Clause
%YAML 1.2
---
$id: http://devicetree.org/schemas/input/kionix,kx022a.yaml#
$schema: http://devicetree.org/meta-schemas/core.yaml#

title: ROHM/Kionix KX022A Accelerometer bindings

maintainers:
  - Matti Vaittinen <matti.vaittinen@fi.rohmeurope.com>

description: |
  KX022A is a 3-axis accelerometer with all kinds of cool stuff.

properties:
  compatible:
    oneOf:
      - items:
        - const: kionix,kx022a-i2c
        - const: kionix,kx022a-spi

  reg:
    description:
      I2C slave address or SPI chip-select.
    maxItems: 1

  interrupts:
    maxItems: 1

  kionix,xyz-axis-map:
    description: |
      Array specifying the axis orientation. Indicate which of the three axis
      is 'X', 'Y', and 'Z' by integers '0', '1' and '2'. First item in array
      specifies the orientation for accelerometer axis-0, second for axis-1 and
      third for axis-2. Eg. <0 1 2> would indicate IC positioning where
      axis-0 is X, axis-1 is Y and axis-2 is Z.
    $ref: "/schemas/types.yaml#/definitions/uint32-array"
    items:
      minimum: 0
      maximum: 2
    minItems: 3
    maxItems: 3
    default: [0, 1, 2]

  kionix,invert-x-axis:
    description: |
      Whether the X-axis directions is inverted or not depending on
      the sensor placement.
    type: boolean

  kionix,invert-y-axis:
    description: |
      Whether the Y-axis directions is inverted or not depending on
      the sensor placement.
    type: boolean

  kionix,invert-x-axis:
    description: |
      Whether the X-axis directions is inverted or not depending on
      the sensor placement.
    type: boolean

  kionix,g-range-milli-g:
    description: |
      The selected G-range for measuring acceleration. 2000 indicates 2 g,
      4000 indicates 4 g, ...
    $ref: "/schemas/types.yaml#/definitions/uint32"
    enum: [2, 4, 8, 16]

required:
  - compatible
  - reg
  - interrupts

additionalProperties: false

examples:
  - |
    #include <dt-bindings/interrupt-controller/irq.h>
    i2c {
        #address-cells = <1>;
        #size-cells = <0>;
          accel@1f {
            compatible = "kionix,kx022a-i2c";
            reg = <0x1f>;

            interrupt-parent = <&gpio1>;
            interrupts = <29 IRQ_TYPE_LEVEL_LOW>;

            kionix,g-range-milli-g = <2000>;
            kionix,xyz-axis-map = <0 1 2>;
        };
    }
```

## Documentation/devicetree/bindings/mfd/rohm,bd71828-pmic.txt
```
* ROHM BD71828 Power Management Integrated Circuit bindings

BD71828GW is a single-chip power management IC for battery-powered portable
devices. The IC integrates 7 buck converters, 7 LDOs, and a 1500 mA single-cell
linear charger. Also included is a Coulomb counter, a real-time clock (RTC),
and a 32.768 kHz clock gate.

Required properties:
 - compatible			: Should be "rohm,bd71828".
 - reg				: I2C slave address.
 - interrupt-parent		: Phandle to the parent interrupt controller.
 - interrupts			: The interrupt line the device is connected to.
 - clocks			: The parent clock connected to PMIC.
 - #clock-cells			: Should be 0.
 - regulators			: List of child nodes that specify the
				  regulators. Please see
				  ../regulator/rohm,bd71828-regulator.txt
 - gpio-controller		: To indicate BD71828 acts as a GPIO controller.
 - #gpio-cells			: Should be 2. The first cell is the pin number
				  and the second cell is used to specify flags.
				  See ../gpio/gpio.txt for more information.

The BD71828 RUN state is divided into 4 configurable run-levels named RUN0,
RUN1, RUN2 and RUN3. Bucks 1, 2, 6 and 7 can be either controlled individually
via I2C, or some/all of them can be bound to run-levels and controlled as a
group. If bucks are controlled individually these run-levels are ignored. See
../regulator/rohm,bd71828-regulator.txt for how to define regulator voltages
for run-levels. Run-levels can be changed by I2C or GPIO depending on PMIC's OTP
configuration.

Optional properties:
- clock-output-names		: Should contain name for output clock.
- rohm,dvs-vsel-gpios		: GPIOs used to control PMIC run-levels. Should
				  describe two GPIOs. (See run-level control in
				  data-sheet). If this property is omitted but
				  some bucks are marked to be controlled by
				  run-levels - then OTP option allowing
				  run-level control via I2C is assumed.
- rohm,lid-open-high		: HALL sensor used to detect the LID position
				  can be connected to the PMIC HALL_INPUT pin.
				  Default is that LID is open when HALL_INPUT
				  is LOW. This property can be used to invert
				  this logic.
- gpio-reserved-ranges		: Usage of GPIO pins can be changed via OTP.
				  This property can be used to mark the pins
				  which should not be configured for GPIO.
				  Please see the ../gpio/gpio.txt for more
				  information.

Example:

        /* external oscillator node */
        osc: oscillator {
                compatible = "fixed-clock";
                #clock-cells = <1>;
                clock-frequency  = <32768>;
                clock-output-names = "osc";
        };

	pmic: pmic@4b {
		compatible = "rohm,bd71828";
		reg = <0x4b>;
		interrupt-parent = <&gpio1>;
		interrupts = <29 GPIO_ACTIVE_LOW>;
		clocks = <&osc 0>;
		#clock-cells = <0>;
		clock-output-names = "bd71828-32k-out";
		gpio-controller;
		#gpio-cells = <2>;
		ngpios = <4>;
		gpio-reserved-ranges = <0 1 2 1>;
		gpio-line-names = "EPDEN";
		rohm,dvs-vsel-gpios = <&gpio1 12 0>,
				      <&gpio1 13 0>;
		regulators {
			buck1: BUCK1 {
				regulator-name = "buck1";
				regulator-min-microvolt = <500000>;
				regulator-max-microvolt = <2000000>;
				regulator-ramp-delay = <2500>;
				rohm,dvs-runlvl-ctrl;
				rohm,dvs-runlevel0-voltage = <500000>;
				rohm,dvs-runlevel1-voltage = <506250>;
				rohm,dvs-runlevel2-voltage = <512500>;
				rohm,dvs-runlevel3-voltage = <518750>;
				regulator-boot-on;
			};
			buck2: BUCK2 {
				regulator-name = "buck2";
				regulator-min-microvolt = <500000>;
				regulator-max-microvolt = <2000000>;
				regulator-ramp-delay = <2500>;
				rohm,dvs-runlvl-ctrl;
				rohm,dvs-runlevel0-voltage = <500000>;
				rohm,dvs-runlevel1-voltage = <506250>;
				rohm,dvs-runlevel2-voltage = <512500>;
				rohm,dvs-runlevel3-voltage = <518750>;
				regulator-boot-on;
			};
			buck3: BUCK3 {
				regulator-name = "buck3";
				regulator-min-microvolt = <1200000>;
				regulator-max-microvolt = <2000000>;
				regulator-boot-on;
			};
			buck4: BUCK4 {
				regulator-name = "buck4";
				regulator-min-microvolt = <1000000>;
				regulator-max-microvolt = <1800000>;
				regulator-boot-on;
			};
			buck5: BUCK5 {
				regulator-name = "buck5";
				regulator-min-microvolt = <2500000>;
				regulator-max-microvolt = <3300000>;
				regulator-boot-on;
			};
			buck6: BUCK6 {
				regulator-name = "buck6";
				regulator-min-microvolt = <500000>;
				regulator-max-microvolt = <2000000>;
				regulator-ramp-delay = <2500>;
				rohm,dvs-runlvl-ctrl;
				rohm,dvs-runlevel0-voltage = <500000>;
				rohm,dvs-runlevel1-voltage = <506250>;
				rohm,dvs-runlevel2-voltage = <512500>;
				rohm,dvs-runlevel3-voltage = <518750>;
				regulator-boot-on;
			};
			buck7: BUCK7 {
				regulator-name = "buck7";
				regulator-min-microvolt = <500000>;
				regulator-max-microvolt = <2000000>;
				regulator-ramp-delay = <2500>;
				rohm,dvs-runlvl-ctrl;
				rohm,dvs-runlevel0-voltage = <500000>;
				rohm,dvs-runlevel1-voltage = <506250>;
				rohm,dvs-runlevel2-voltage = <512500>;
				rohm,dvs-runlevel3-voltage = <518750>;
				regulator-boot-on;
			};
			ldo1: LDO1 {
				regulator-name = "ldo1";
				regulator-min-microvolt = <800000>;
				regulator-max-microvolt = <3300000>;
				regulator-boot-on;
			};
			ldo2: LDO2 {
				regulator-name = "ldo2";
				regulator-min-microvolt = <800000>;
				regulator-max-microvolt = <3300000>;
				regulator-boot-on;
			};
			ldo3: LDO3 {
				regulator-name = "ldo3";
				regulator-min-microvolt = <800000>;
				regulator-max-microvolt = <3300000>;
				regulator-boot-on;
			};
			ldo4: LDO4 {
				regulator-name = "ldo4";
				regulator-min-microvolt = <800000>;
				regulator-max-microvolt = <3300000>;
				regulator-boot-on;
			};
			ldo5: LDO5 {
				regulator-name = "ldo5";
				regulator-min-microvolt = <800000>;
				regulator-max-microvolt = <3300000>;
				regulator-boot-on;
			};
			ldo6: LDO6 {
				regulator-name = "ldo6";
				regulator-min-microvolt = <1800000>;
				regulator-max-microvolt = <1800000>;
				regulator-boot-on;
			};
			ldo7_reg: LDO7 {
				regulator-name = "ldo7";
				regulator-min-microvolt = <800000>;
				regulator-max-microvolt = <3300000>;
				regulator-boot-on;
			};
		};
	};
```
