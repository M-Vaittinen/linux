## Documentation/devicetree/bindings/regulator/rohm,bd71828-regulator.txt
```
ROHM BD71828 Power Management Integrated Circuit regulator bindings

Required properties:
 - regulator-name: should be "buck1", ..., "buck7", and "ldo1", ..., "ldo7"

List of regulators provided by this controller. BD71828 regulators node
should be sub node of the BD71828 MFD node. See BD71828 MFD bindings at
Documentation/devicetree/bindings/mfd/rohm,bd71828-pmic.txt
Regulator nodes should be named to BUCK_<number> and LDO_<number>. The
definition for each of these nodes is defined using the standard
binding for regulators at
Documentation/devicetree/bindings/regulator/regulator.txt.

The valid names for BD71828 regulator nodes are:
BUCK1, BUCK2, BUCK3, BUCK4, BUCK5, BUCK6, BUCK7
LDO1, LDO2, LDO3, LDO4, LDO5, LDO6, LDO7

Optional properties:
- rohm,dvs-run-voltage		: PMIC default "RUN" state voltage in uV.
				  See below table for bucks which support this.
- rohm,dvs-idle-voltage		: PMIC default "IDLE" state voltage in uV.
				  See below table for bucks which support this.
- rohm,dvs-suspend-voltage	: PMIC default "SUSPEND" state voltage in uV.
				  See below table for bucks which support this.
- rohm,dvs-lpsr-voltage		: PMIC default "LPSR" state voltage in uV.
- rohm,dvs-runlvl-ctrl		: buck control is done based on run-level.
				  Regulator is not individually controllable.
				  See ../mfd/rohm,bd71828-pmic.txt for how to
				  specify run-level control mechanism. Only
				  bucks 1, 2, 6 and 7 support this.
- rohm,dvs-runlevel0-voltage    : voltage for run-level 0. Microvolts.
- rohm,dvs-runlevel1-voltage	: voltage for run-level 1. Microvolts.
- rohm,dvs-runlevel2-voltage	: voltage for run-level 1. Microvolts.
- rohm,dvs-runlevel3-voltage	: voltage for run-level 1. Microvolts.

- Any optional property defined in bindings/regulator/regulator.txt

Supported default DVS states:

buck		| run		| idle		| suspend	| lpsr
-----------------------------------------------------------------------------
1, 2, 6, and 7	| supported	| supported	| 	supported (*)
----------------------------------------------------------------------------
3, 4, and 5	| 			supported (**)
----------------------------------------------------------------------------
(*)  LPSR and SUSPEND states use same voltage but both states have own enable /
     disable settings. Voltage 0 can be specified for a state to make regulator
     disabled on that state.
(**) All states use same voltage but have own enable / disable settings. Voltage
     0 can be specified for a state to make regulator disabled on that state.

BD71847:
buck	| dvs-run-voltage	| dvs-idle-voltage	| dvs-suspend-voltage
-----------------------------------------------------------------------------
1	| supported		| supported		| supported
----------------------------------------------------------------------------
2	| supported		| supported		| not supported
----------------------------------------------------------------------------
rest	| not supported		| not supported		| not supported

Example:
regulators {
	buck1: BUCK1 {
		regulator-name = "buck1";
		... tbd
	};
	buck2: BUCK2 {
		regulator-name = "buck2";
		... tbd
	};
	buck3: BUCK3 {
		regulator-name = "buck3";
		... tbd
	};
	buck4: BUCK4 {
		regulator-name = "buck4";
		... tbd
	};
	buck5: BUCK5 {
		regulator-name = "buck5";
		... tbd
	};
	buck6: BUCK6 {
		regulator-name = "buck6";
		... tbd
	};
	buck7: BUCK7 {
		regulator-name = "buck7";
		... tbd
	};

	ldo1: LDO1 {
		regulator-name = "ldo1";
		... tbd
	};
	ldo2: LDO2 {
		regulator-name = "ldo2";
		... tbd
	};
	ldo3: LDO3 {
		regulator-name = "ldo3";
		... tbd
	};
	ldo4: LDO4 {
		regulator-name = "ldo4";
		... tbd
	};
	ldo5: LDO5 {
		regulator-name = "ldo5";
		... tbd
	};
	ldo6: LDO6 {
		regulator-name = "ldo6";
		... tbd
	};
	ldo7_reg: LDO7 {
		regulator-name = "ldo7";
		... tbd
	};
};
```

## Documentation/devicetree/bindings/regulator/rohm,bd71828-regulator.yaml
```yaml
# SPDX-License-Identifier: GPL-2.0-only
%YAML 1.2
---
$id: http://devicetree.org/schemas/regulator/rohm,bd71828-regulator.yaml#
$schema: http://devicetree.org/meta-schemas/core.yaml#

title: ROHM BD71828 Power Management Integrated Circuit regulators

maintainers:
  - Matti Vaittinen <matti.vaittinen@fi.rohmeurope.com>

description: |
  This module is part of the ROHM BD71828 MFD device. For more details
  see Documentation/devicetree/bindings/mfd/rohm,bd71828-pmic.yaml.

  The regulator controller is represented as a sub-node of the PMIC node
  on the device tree.

  Regulator nodes should be named to BUCK_<number> and LDO_<number>.
  The valid names for BD71828 regulator nodes are
  BUCK1, BUCK2, BUCK3, BUCK4, BUCK5, BUCK6, BUCK7
  LDO1, LDO2, LDO3, LDO4, LDO5, LDO6, LDO7

patternProperties:
  "^LDO[1-7]$":
    type: object
    allOf:
      - $ref: regulator.yaml#
    description:
      Properties for single LDO regulator.

    properties:
      #Is there a nice way to check the name is same as node name but lower case
      regulator-name:
        pattern: "^ldo[1-7]$"
        description:
          should be "ldo1", ..., "ldo7"

  "^BUCK[1-7]$":
    type: object
    allOf:
      - $ref: regulator.yaml#
    description:
      Properties for single BUCK regulator.

    properties:
      #Is there a nice way to check the name is same as node name but lower case
      regulator-name:
        pattern: "^buck[1-7]$"
        description:
          should be "buck1", ..., "buck7"

      rohm,dvs-run-voltage:
        allOf:
          - $ref: "/schemas/types.yaml#/definitions/uint32"
          - minimum: 0
            maximum: 3300000
        description:
          PMIC default "RUN" state voltage in uV. See below table for
          bucks which support this. 0 means disabled.

      rohm,dvs-idle-voltage:
        allOf:
          - $ref: "/schemas/types.yaml#/definitions/uint32"
          - minimum: 0
            maximum: 3300000
        description:
          PMIC default "IDLE" state voltage in uV. See below table for
          bucks which support this. 0 means disabled.

      rohm,dvs-suspend-voltage:
        allOf:
          - $ref: "/schemas/types.yaml#/definitions/uint32"
          - minimum: 0
            maximum: 3300000
        description:
          PMIC default "SUSPEND" state voltage in uV. See below table for
          bucks which support this. 0 means disabled.

      rohm,dvs-lpsr-voltage:
        allOf:
          - $ref: "/schemas/types.yaml#/definitions/uint32"
          - minimum: 0
            maximum: 3300000
        description:
          PMIC default "LPSR" state voltage in uV. See below table for
          bucks which support this. 0 means disabled.

#Supported default DVS states:
#buck		| run		| idle		| suspend	| lpsr
#----------------------------------------------------------------------------
#1, 2, 6, and 7	| supported	| supported	| 	supported (*)
#----------------------------------------------------------------------------
#3, 4, and 5	| 			supported (**)
#----------------------------------------------------------------------------
#(*)  LPSR and SUSPEND states use same voltage but both states have own enable /
#     disable settings. Voltage 0 can be specified for a state to make regulator
#     disabled on that state.
#(**) All states use same voltage but have own enable / disable settings.
#     Voltage 0 can be specified for a state to make regulator disabled on that
#     state.

      rohm,dvs-runlvl-ctrl:
        description: |
          buck control is done based on run-level. Regulator is not
          individually controllable. See ../mfd/rohm,bd71828-pmic.yaml for
          how to specify run-level control mechanism. Only bucks 1, 2, 6
          and 7 support this.
        type: boolean

      rohm,dvs-runlevel-microvolts:
        minimum: 0
        maximum: 2000000
        maxItems: 4
        description:
          Array of voltages for run-levels. First value is for run-level 0,
          second for run-level 1 etc. Microvolts.

    required:
      - regulator-name
  additionalProperties: false
additionalProperties: false
```
